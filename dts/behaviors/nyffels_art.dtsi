/* SPDX-License-Identifier: MIT */

/ {
    behaviors {
        // Keep this node name within the split BLE behavior-name limit (8 chars).
        nyart: nyart {
            compatible = "nyffels,display-art";
            #binding-cells = <1>;
        };
    };
};
