## dts/bindings/behaviors/nyffels,display-art.yaml
```yaml
# SPDX-License-Identifier: MIT
description: Set the right-hand Nyffels display artwork over the split link
compatible: "nyffels,display-art"
include: one_param.yaml
```
